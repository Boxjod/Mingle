## sdkconfig.defaults
```kconfig
# Box2Robot CAM SDK Configuration — ESP32-S3 M5AtomS3R-CAM

# Flash
CONFIG_ESPTOOLPY_FLASHSIZE_8MB=y
CONFIG_PARTITION_TABLE_CUSTOM=y
CONFIG_PARTITION_TABLE_CUSTOM_FILENAME="partitions.csv"

# PSRAM — camera framebuffers need PSRAM
CONFIG_ESP32S3_SPIRAM_SUPPORT=y
CONFIG_SPIRAM=y
CONFIG_SPIRAM_MODE_OCT=y
CONFIG_SPIRAM_SPEED_80M=y

# Camera
CONFIG_CAMERA_TASK_STACK_SIZE=4096

# WiFi — 稳定性优化
CONFIG_ESP_WIFI_SOFTAP_SUPPORT=y
CONFIG_ESP_WIFI_NVS_ENABLED=y
CONFIG_ESP_WIFI_STA_DISCONNECTED_PM_ENABLE=n
CONFIG_ESP_WIFI_AMPDU_TX_ENABLED=n
CONFIG_ESP_WIFI_AMPDU_RX_ENABLED=n

# Bluetooth — off
CONFIG_BT_ENABLED=n

# Arduino
CONFIG_AUTOSTART_ARDUINO=n

# LWIP — TCP 缓冲匹配 JPEG 帧大小 + 连接保活
CONFIG_LWIP_MAX_SOCKETS=10
CONFIG_LWIP_SO_REUSE=y
CONFIG_LWIP_TCP_SND_BUF_DEFAULT=32768
CONFIG_LWIP_TCP_WND_DEFAULT=32768
CONFIG_LWIP_TCP_NODELAY_DEFAULT=y
CONFIG_LWIP_TCP_KEEPALIVE_DEFAULT=y
CONFIG_LWIP_TCP_KEEP_CONNECTION_WHEN_IP_CHANGES=y
CONFIG_LWIP_IRAM_OPTIMIZATION=y

# FreeRTOS
CONFIG_FREERTOS_HZ=1000

# Main task stack
CONFIG_ESP_MAIN_TASK_STACK_SIZE=16384

# Console — UART primary + USB Serial/JTAG mirror (the ONLY config that works)
CONFIG_ESP_CONSOLE_UART_DEFAULT=y
CONFIG_ESP_CONSOLE_SECONDARY_USB_SERIAL_JTAG=y

# Logging
CONFIG_LOG_DEFAULT_LEVEL_INFO=y

# HTTPS — certificate bundle for server API
CONFIG_ESP_TLS_USING_MBEDTLS=y
CONFIG_MBEDTLS_CERTIFICATE_BUNDLE=y
CONFIG_MBEDTLS_CERTIFICATE_BUNDLE_DEFAULT_FULL=y

# HTTP client
CONFIG_ESP_HTTP_CLIENT_ENABLE_HTTPS=y

# OTA — 自动回滚: 新固件崩溃时 bootloader 自动切回旧分区
CONFIG_BOOTLOADER_APP_ROLLBACK_ENABLE=y

# Compiler
CONFIG_COMPILER_OPTIMIZATION_SIZE=y
```
